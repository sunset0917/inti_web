// 1. CONFIGURACIÓN: MODO PÚBLICO (NO AUTH)
#define ENABLE_NO_AUTH 
#define ENABLE_DATABASE

#include <Arduino.h>
#include <WiFi.h>
#include <FirebaseClient.h>
#include <WiFiClientSecure.h>
#include <ESP32Servo.h>
#include <Adafruit_GFX.h>
#include <Adafruit_SSD1306.h>




// =========================
// OLED
// =========================
#define ANCHO 128
#define ALTO 64
Adafruit_SSD1306 oled(ANCHO, ALTO, &Wire, -1);



// =========================
// SERVOS
// =========================
static const int servoPin_arriba = 19;
static const int servoPin_abajo  = 18;

Servo servo1; // horizontal
Servo servo2; // vertical

int posicionActualServo  = 105;
int posicionActualServo2 = 93;

int amplitud = 30;
int amplitudVertical = 15;

// =========================
// VARIABLES
// =========================
volatile bool nuevoDatoExpresion = false;
volatile bool nuevoDatoMovimiento = false;
int ultimoValorMovimiento = -999;
int ultimaExpresion = -999;
volatile int valorEmocion = -1;
volatile int valorMovimiento = 0;

unsigned long ultimaPeticion = 0;
const int intervalo = 2000;

// =========================
// DEBUG TIMES
// =========================
unsigned long t_getExp = 0;
unsigned long t_getMov = 0;

unsigned long t_llegaExp = 0;
unsigned long t_llegaMov = 0;

unsigned long t_inicioRender = 0;
unsigned long t_finRender = 0;

unsigned long t_inicioServo = 0;
unsigned long t_finServo = 0;

// =========================
// FIREBASE
// =========================


//
// BITMAP (IMÁGENES)
const unsigned char cansado_bitmap[] PROGMEM = { 
  0xff, 0xff, 0xff, 0xff, 0xff, 0xff, 0xff, 0xff, 0xff, 0xff, 0xff, 0xff, 0xff, 0xff, 0xff, 0xff, 
	0xff, 0xff, 0xff, 0xff, 0xff, 0xff, 0xff, 0xff, 0xf0, 0x7f, 0xff, 0xff, 0xff, 0xff, 0xff, 0xff, 
	0xff, 0xff, 0xff, 0xff, 0xff, 0xff, 0xff, 0xff, 0xc0, 0x3f, 0xff, 0xff, 0xff, 0xff, 0xff, 0xff, 
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	0xff, 0xff, 0xff, 0xff, 0xff, 0xff, 0xff, 0xff, 0xff, 0xff, 0xff, 0xff, 0xff, 0xff, 0xff, 0xff

};
const unsigned char feliz_bitmap[] PROGMEM = { 
  0xff, 0xff, 0xff, 0xff, 0xff, 0xff, 0xff, 0xff, 0xff, 0xff, 0xff, 0xff, 0xff, 0xff, 0xff, 0xff, 
	0xff, 0xff, 0xff, 0xff, 0xff, 0xff, 0xfe, 0x0f, 0xff, 0xff, 0xff, 0xff, 0xff, 0xff, 0xff, 0xff, 
	0xff, 0xff, 0xff, 0xff, 0xff, 0xff, 0xfc, 0x03, 0xff, 0xff, 0xff, 0xff, 0xff, 0xff, 0xff, 0xff, 
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	0xff, 0xff, 0xff, 0xff, 0xff, 0xff, 0xff, 0xff, 0xff, 0xff, 0xff, 0xff, 0xff, 0xff, 0xff, 0xff
 };

// 'OJOS BRILLOSOS', 128x64px
const unsigned char brilloso_bitmap [] PROGMEM = {
	0xff, 0xff, 0xff, 0xff, 0xff, 0xff, 0xff, 0xff, 0xff, 0xff, 0xff, 0xff, 0xff, 0xff, 0xff, 0xff, 
	0xff, 0xff, 0xff, 0xff, 0xff, 0xff, 0xff, 0xf8, 0x01, 0xff, 0xff, 0xff, 0xff, 0xff, 0xff, 0xff, 
	0xff, 0xff, 0xff, 0xff, 0xff, 0xff, 0xf8, 0x00, 0x00, 0x03, 0xff, 0xff, 0xff, 0xff, 0xff, 0xff, 
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	0xff, 0xff, 0xff, 0xff, 0xff, 0xff, 0xff, 0xff, 0xff, 0xff, 0xff, 0xff, 0xff, 0xff, 0xff, 0xff
};



//



// =========================
// OBJETOS FIREBASE
// =========================
WiFiClientSecure ssl_client;

using AsyncClient = AsyncClientClass;

// CORRECCIÓN AQUÍ: Solo pasamos el cliente SSL, sin getStackHeap
AsyncClient aClient(ssl_client);

NoAuth no_auth; 
FirebaseApp app;
RealtimeDatabase Database;

// ====================================================
// MOVIMIENTO SUAVE
// ====================================================
void moverSuave(int fin) {
  fin = constrain(fin, 5, 175);

  int inicio = posicionActualServo;
  if (inicio == fin) return;

  if (inicio < fin) {
    for (int pos = inicio; pos <= fin; pos++) {
      servo1.write(pos);
      delay(15);
    }
  } else {
    for (int pos = inicio; pos >= fin; pos--) {
      servo1.write(pos);
      delay(15);
    }
  }

  posicionActualServo = fin;
}

void moverSuaveVertical(int fin) {
  fin = constrain(fin, 5, 175);

  int inicio = posicionActualServo2;
  if (inicio == fin) return;

  if (inicio < fin) {
    for (int pos = inicio; pos <= fin; pos++) {
      servo2.write(pos);
      delay(15);
    }
  } else {
    for (int pos = inicio; pos >= fin; pos--) {
      servo2.write(pos);
      delay(15);
    }
  }

  posicionActualServo2 = fin;
}

// ====================================================
// GESTOS
// ====================================================
void mirarAbajo() {
  int centro = posicionActualServo2;
  moverSuaveVertical(centro + amplitudVertical);
  delay(600);
  moverSuaveVertical(centro);
}

void mirarArriba() {
  int centro = posicionActualServo2;
  moverSuaveVertical(centro - amplitudVertical);
  delay(600);
  moverSuaveVertical(centro);
}

void mirarDerecha() {
  int centro = posicionActualServo;
  moverSuave(centro + amplitud);
  delay(600);
  moverSuave(centro);
}

void mirarIzquierda() {
  int centro = posicionActualServo;
  moverSuave(centro - amplitud);
  delay(600);
  moverSuave(centro);
}

void negarCabeza() {
  int centro = posicionActualServo;
  int derecha = constrain(centro + amplitud, 5, 175);
  int izquierda = constrain(centro - amplitud, 5, 175);

  moverSuave(derecha);
  moverSuave(izquierda);
  moverSuave(centro);
}

// ====================================================
// CALLBACK EXPRESIONES
// ====================================================
void processExpresion(AsyncResult &aResult) {

  if (aResult.isError()) return;
  if (!aResult.available()) return;

  int nuevaExp = aResult.payload().toInt();

  if (nuevaExp == ultimaExpresion) return;

  ultimaExpresion = nuevaExp;

  t_llegaExp = micros();

  valorEmocion = nuevaExp;
  nuevoDatoExpresion = true;
}

// ====================================================
// CALLBACK MOVIMIENTO
// ====================================================
void processMovimiento(AsyncResult &aResult) {

  if (aResult.isError()) return;
  if (!aResult.available()) return;

  int nuevoValor = aResult.payload().toInt();

  // ignorar si no cambió
  if (nuevoValor == ultimoValorMovimiento) return;

  ultimoValorMovimiento = nuevoValor;

  // ignorar reposo
  if (nuevoValor == 0) return;

  t_llegaMov = micros();

  valorMovimiento = nuevoValor;
  nuevoDatoMovimiento = true;
}
// ====================================================
// SETUP
// ====================================================
void setup() {

  Serial.begin(115200);

  // OLED
  if (!oled.begin(SSD1306_SWITCHCAPVCC, 0x3C)) {
    Serial.println("Error OLED");
    while (1);
  }

  oled.clearDisplay();
  oled.setTextSize(1);
  oled.setTextColor(WHITE);
  oled.setCursor(0, 0);
  oled.println("Conectando WiFi...");
  oled.display();

  // Servos
  ESP32PWM::allocateTimer(0);

  servo1.setPeriodHertz(50);
  servo2.setPeriodHertz(50);

  servo1.attach(servoPin_abajo, 500, 2400);
  servo2.attach(servoPin_arriba, 500, 2400);

  servo1.write(posicionActualServo);
  servo2.write(posicionActualServo2);

  // WiFi
  WiFi.begin(WIFI_SSID, WIFI_PASSWORD);

  while (WiFi.status() != WL_CONNECTED) {
    delay(300);
    Serial.print(".");
  }

  Serial.println("\nWiFi OK");

  // Firebase
  ssl_client.setInsecure();

  initializeApp(aClient, app, getAuth(no_auth));
  app.getApp<RealtimeDatabase>(Database);
  Database.url(DATABASE_URL);

  oled.clearDisplay();
  oled.setCursor(0, 0);
  oled.println("Sistema listo");
  oled.display();
}

// ====================================================
// LOOP
// ====================================================
void loop() {

  app.loop();

  // ====================================
  // RENDER OLED
  // ====================================
  if (nuevoDatoExpresion) {

    t_inicioRender = micros();

    oled.clearDisplay();

    if (valorEmocion == 0) {
      oled.drawBitmap(0, 0, feliz_bitmap, 128, 64, WHITE);
    }
    else if (valorEmocion == 1) {
      oled.drawBitmap(0, 0, cansado_bitmap, 128, 64, WHITE);
    }
    else if (valorEmocion == 2) {
      oled.drawBitmap(0, 0, brilloso_bitmap, 128, 64, WHITE);
    }

    oled.display();

    t_finRender = micros();

    Serial.println("----- OLED -----");
    Serial.printf("Render (milisegundos): %lu ms\n",
      (t_finRender - t_inicioRender)/1000);

    Serial.printf("Firebase -> Visible: %lu ms\n (milisegundos)",
      (t_finRender - t_llegaExp)/1000);

    nuevoDatoExpresion = false;
  }

  // ====================================
  // MOVIMIENTO SERVOS
  // ====================================
  if (nuevoDatoMovimiento) {

    if (valorMovimiento != 0) {

      t_inicioServo = micros();

      switch (valorMovimiento) {
        case 1: mirarArriba();    break;
        case 2: mirarAbajo();     break;
        case 3: mirarDerecha();   break;
        case 4: mirarIzquierda(); break;
        case 5: negarCabeza();    break;
      }

      t_finServo = micros();

      Serial.println("----- SERVO -----");
      Serial.printf("Movimiento total (milisegundos): %lu us\n",
	  (t_finServo - t_inicioServo)/1000);

      Serial.printf("Firebase -> Fin movimiento (milisegundos): %lu us\n",
        (t_finServo - t_llegaMov)/1000);

      // reset a reposo
      Database.set(aClient, "/movimiento", 0);
    }

    nuevoDatoMovimiento = false;
  }

  // ====================================
  // LECTURA FIREBASE
  // ====================================
  if (app.ready() &&
      millis() - ultimaPeticion > intervalo) {

    ultimaPeticion = millis();

    t_getExp = micros();
    Database.get(aClient,
                 "/expresiones",
                 processExpresion);

    t_getMov = micros();
    Database.get(aClient,
                 "/movimiento",
                 processMovimiento);
  }
}
