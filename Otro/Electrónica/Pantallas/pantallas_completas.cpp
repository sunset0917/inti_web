// AHora ya tenemos una sola lógica de valor de expresion para no tener que leer varias acciones a la vez:



// =========================
// OLED
// =========================
#define ANCHO 128
#define ALTO 64
Adafruit_SSD1306 oled(ANCHO, ALTO, &Wire, -1);

// VARIABLES
volatile bool nuevoDatoRecibido = false; 
volatile int valorEmocion = -1;
unsigned long ultimaPeticion = 0;


//
// BITMAP (IMÁGENES)
const unsigned char cansado_bitmap[] PROGMEM = { 
  0xff, 0xff, 0xff, 0xff, 0xff, 0xff, 0xff, 0xff, 0xff, 0xff, 0xff, 0xff, 0xff, 0xff, 0xff, 0xff, 
	0xff, 0xff, 0xff, 0xff, 0xff, 0xff, 0xff, 0xff, 0xf0, 0x7f, 0xff, 0xff, 0xff, 0xff, 0xff, 0xff, 
	0xff, 0xff, 0xff, 0xff, 0xff, 0xff, 0xff, 0xff, 0xc0, 0x3f, 0xff, 0xff, 0xff, 0xff, 0xff, 0xff, 
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	0xff, 0xff, 0xff, 0xff, 0xff, 0xff, 0xff, 0xff, 0xff, 0xff, 0xff, 0xff, 0xff, 0xff, 0xff, 0xff

};
const unsigned char feliz_bitmap[] PROGMEM = { 
  0xff, 0xff, 0xff, 0xff, 0xff, 0xff, 0xff, 0xff, 0xff, 0xff, 0xff, 0xff, 0xff, 0xff, 0xff, 0xff, 
	0xff, 0xff, 0xff, 0xff, 0xff, 0xff, 0xfe, 0x0f, 0xff, 0xff, 0xff, 0xff, 0xff, 0xff, 0xff, 0xff, 
	0xff, 0xff, 0xff, 0xff, 0xff, 0xff, 0xfc, 0x03, 0xff, 0xff, 0xff, 0xff, 0xff, 0xff, 0xff, 0xff, 
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	0xff, 0xff, 0xff, 0xff, 0xff, 0xff, 0xff, 0xff, 0xff, 0xff, 0xff, 0xff, 0xff, 0xff, 0xff, 0xff
 };

// 'OJOS BRILLOSOS', 128x64px
const unsigned char brilloso_bitmap [] PROGMEM = {
	0xff, 0xff, 0xff, 0xff, 0xff, 0xff, 0xff, 0xff, 0xff, 0xff, 0xff, 0xff, 0xff, 0xff, 0xff, 0xff, 
	0xff, 0xff, 0xff, 0xff, 0xff, 0xff, 0xff, 0xf8, 0x01, 0xff, 0xff, 0xff, 0xff, 0xff, 0xff, 0xff, 
	0xff, 0xff, 0xff, 0xff, 0xff, 0xff, 0xf8, 0x00, 0x00, 0x03, 0xff, 0xff, 0xff, 0xff, 0xff, 0xff, 
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	0xff, 0xff, 0xff, 0xff, 0xff, 0xff, 0xff, 0xff, 0xff, 0xff, 0xff, 0xff, 0xff, 0xff, 0xff, 0xff
};



//



// =========================
// OBJETOS FIREBASE
// =========================
WiFiClientSecure ssl_client;

using AsyncClient = AsyncClientClass;

// CORRECCIÓN AQUÍ: Solo pasamos el cliente SSL, sin getStackHeap
AsyncClient aClient(ssl_client);

NoAuth no_auth; 
FirebaseApp app;
RealtimeDatabase Database;

// =========================
// CALLBACK DE DATOS
// =========================
void processData(AsyncResult &aResult) {
  if (aResult.isError()) {
    // Imprime el error si ocurre
    Serial.printf("Error: %s\n", aResult.error().message().c_str());
    return;
  }

  if (aResult.available()) {
      Serial.print("[RUTA] "); Serial.println(aResult.path().c_str());
      String data = aResult.payload();
      Serial.print("[VALOR] "); Serial.println(data);
      
      if(data != "null") {
        valorEmocion = data.toInt();
        nuevoDatoRecibido = true;
      }
  }
}

// =========================
// SETUP
// =========================
void setup() {
  Serial.begin(115200);

  // INICIAR OLED
  if(!oled.begin(SSD1306_SWITCHCAPVCC, 0x3C)) { 
    Serial.println(F("Error OLED")); for(;;);
  }
  oled.clearDisplay();
  oled.setTextSize(1);
  oled.setTextColor(SSD1306_WHITE);
  oled.setCursor(0,0);
  oled.println("Conectando WiFi...");
  oled.display();

  // INICIAR WIFI
  WiFi.begin(WIFI_SSID, WIFI_PASSWORD);
  while (WiFi.status() != WL_CONNECTED) {
    delay(300); Serial.print(".");
  }
  Serial.println("\nWiFi OK");

  // SSL INSEGURO (necesario si no sincronizamos fecha/hora estrictamente)
  ssl_client.setInsecure();

  Serial.println("Iniciando Firebase...");

  // 1. INICIALIZAR APP
  initializeApp(aClient, app, getAuth(no_auth));

  // 2. VINCULAR DATABASE (ESTO SOLUCIONA EL ERROR "APP NOT ASSIGNED")
  app.getApp<RealtimeDatabase>(Database);

  // 3. URL
  Database.url(DATABASE_URL);
  
  oled.clearDisplay();
  oled.setCursor(0,0);
  oled.println("Firebase Listo!");
  oled.display();
}

// =========================
// LOOP
// =========================
void loop() {
  // Mantiene la gestión de tareas de Firebase
  app.loop();

  // LÓGICA PANTALLA
  if (nuevoDatoRecibido) {
    oled.clearDisplay();
    if (valorEmocion == 0) {
      oled.drawBitmap(
            0, 0,              // posición x, y
            feliz_bitmap,       // nombre del bitmap
            128, 64,           // ancho y alto
            WHITE              // color del píxel
        );
    } else if (valorEmocion == 1) {
      oled.drawBitmap(
            0, 0,              // posición x, y
            cansado_bitmap,       // nombre del bitmap
            128, 64,           // ancho y alto
            WHITE              // color del píxel
        );
    }
    else if (valorEmocion == 2) {
      oled.drawBitmap(
            0, 0,              // posición x, y
            brilloso_bitmap,       // nombre del bitmap
            128, 64,           // ancho y alto
            WHITE              // color del píxel
        );
    }
    
    oled.display();
    nuevoDatoRecibido = false; 
  }

  // LECTURA DE DATOS
  // Verificamos app.ready() para asegurar que hay conexión
  if (app.ready() && (millis() - ultimaPeticion > 2000)) {
    ultimaPeticion = millis();
    Serial.print("Leemos... ");
    
    // Petición asíncrona
    Database.get(aClient, "/expresiones", processData);
  }
}

