# En este archivo ya unimos las pantallas (sin mux) con los servomotores


// 1. CONFIGURACIÓN: MODO PÚBLICO (NO AUTH)
#define ENABLE_NO_AUTH 
#define ENABLE_DATABASE




#include <Arduino.h>
#include <WiFi.h>
#include <FirebaseClient.h>
#include <WiFiClientSecure.h>
#include <ESP32Servo.h>
#include <Adafruit_GFX.h>
#include <Adafruit_SSD1306.h>


// =========================
// WIFI
// =========================
// (usa tus credenciales)

// =========================
// OLED
// =========================
#define ANCHO 128
#define ALTO 64
Adafruit_SSD1306 oled(ANCHO, ALTO, &Wire, -1);

// =========================
// SERVOS
// =========================
static const int servoPin_arriba = 19;
static const int servoPin_abajo = 18;

Servo servo1;
Servo servo2;

int posicionActualServo = 105;
int posicionActualServo2 = 93;
int amplitud = 30;

// =========================
// FIREBASE
// =========================
WiFiClientSecure ssl_client;
using AsyncClient = AsyncClientClass;
AsyncClient aClient(ssl_client);

NoAuth no_auth; 
FirebaseApp app;
RealtimeDatabase Database;

// =========================
// VARIABLES
// =========================
unsigned long ultimaPeticion = 0;
const int intervalo = 2000;

bool resetNegar = false;
bool resetIzquierda = false;
bool resetDerecha = false;

volatile bool nuevoDatoRecibido = false; 
volatile int valorEmocion = -1;

const unsigned char feliz_bitmap[] PROGMEM = { 
  0xff, 0xff, 0xff, 0xff, 0xff, 0xff, 0xff, 0xff, 0xff, 0xff, 0xff, 0xff, 0xff, 0xff, 0xff, 0xff, 
	0xff, 0xff, 0xff, 0xff, 0xff, 0xff, 0xff, 0xff, 0xff, 0xff, 0xff, 0xff, 0xff, 0xff, 0xff, 0xff, 
	0xff, 0xff, 0xff, 0xff, 0xff, 0xff, 0xff, 0xff, 0xff, 0xff, 0xff, 0xff, 0xff, 0xff, 0xff, 0xff, 
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	0xff, 0xff, 0xff, 0xff, 0xff, 0xff, 0xff, 0xff, 0xff, 0xff, 0xff, 0xff, 0xff, 0xff, 0xff, 0xff


};
const unsigned char cansado_bitmap[] PROGMEM = { 

  0xff, 0xff, 0xff, 0xff, 0xff, 0xff, 0xff, 0xff, 0xff, 0xff, 0xff, 0xff, 0xff, 0xff, 0xff, 0xff, 
	0xff, 0xff, 0xff, 0xff, 0xff, 0xff, 0xff, 0xff, 0xff, 0xff, 0xff, 0xff, 0xff, 0xff, 0xff, 0xff, 
	0xff, 0xff, 0xff, 0xff, 0xff, 0xff, 0xff, 0xff, 0xff, 0xff, 0xff, 0xff, 0xff, 0xff, 0xff, 0xff, 
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	0xff, 0xff, 0xff, 0xff, 0xff, 0xff, 0xff, 0xff, 0xff, 0xff, 0xff, 0xff, 0xff, 0xff, 0xff, 0xff
 };


// =========================
// MOVIMIENTO
// =========================
void moverSuave(int fin) {
  fin = constrain(fin, 5, 175);
  int inicio = posicionActualServo;

  if (inicio < fin) {
    for (int pos = inicio; pos <= fin; pos++) {
      servo1.write(pos);
      delay(10);
    }
  } else {
    for (int pos = inicio; pos >= fin; pos--) {
      servo1.write(pos);
      delay(10);
    }
  }

  posicionActualServo = fin;
}

void negarCabeza() {
  int centro = posicionActualServo;
  int derecha = constrain(centro + amplitud, 5, 175);
  int izquierda = constrain(centro - amplitud, 5, 175);

  for (int pos = centro; pos <= derecha; pos++) {
    servo1.write(pos);
    delay(10);
  }
  for (int pos = derecha; pos >= izquierda; pos--) {
    servo1.write(pos);
    delay(10);
  }
  for (int pos = izquierda; pos <= centro; pos++) {
    servo1.write(pos);
    delay(10);
  }

  posicionActualServo = centro;
}

void mirarIzquierda() {
  int centro = posicionActualServo;
  moverSuave(centro - amplitud);
  delay(2000);
  moverSuave(centro);
}

void mirarDerecha() {
  int centro = posicionActualServo;
  moverSuave(centro + amplitud);
  delay(2000);
  moverSuave(centro);
}

// =========================
// CALLBACK FIREBASE (UNIFICADO)
// =========================
void processData(AsyncResult &aResult) {
  if (aResult.isError()) {
    Serial.println(aResult.error().message());
    return;
  }

  if (aResult.available()) {
    String path = aResult.path().c_str();
    String data = aResult.payload();

    Serial.print("[RUTA] "); Serial.println(path);
    Serial.print("[VALOR] "); Serial.println(data);

    // =====================
    // MOVIMIENTOS
    // =====================
    if (path == "/movimiento/negar" && data == "1") {
      negarCabeza();
      resetNegar = true;
    }

    if (path == "/movimiento/izquierda" && data == "1") {
      mirarIzquierda();
      resetIzquierda = true;
    }

    if (path == "/movimiento/derecha" && data == "1") {
      mirarDerecha();
      resetDerecha = true;
    }

    // =====================
    // EXPRESIONES OLED
    // =====================
    if (path == "/expresiones/feliz") {
      if(data != "null") {
        valorEmocion = data.toInt();
        nuevoDatoRecibido = true;
      }
    }
  }
}

// =========================
// SETUP
// =========================
void setup() {
  Serial.begin(115200);

  // OLED
  if(!oled.begin(SSD1306_SWITCHCAPVCC, 0x3C)) {
    Serial.println("Error OLED");
    while(1);
  }

  oled.clearDisplay();
  oled.setCursor(0,0);
  oled.println("Conectando WiFi...");
  oled.display();

  // SERVOS
  ESP32PWM::allocateTimer(0);
  servo1.setPeriodHertz(50);
  servo2.setPeriodHertz(50);

  servo1.attach(servoPin_abajo, 500, 2400);
  servo2.attach(servoPin_arriba, 500, 2400);

  servo1.write(posicionActualServo);
  servo2.write(posicionActualServo2);

  // WIFI
  WiFi.begin(WIFI_SSID, WIFI_PASSWORD);
  while (WiFi.status() != WL_CONNECTED) {
    delay(300);
    Serial.print(".");
  }

  // FIREBASE
  ssl_client.setInsecure();
  initializeApp(aClient, app, getAuth(no_auth));
  app.getApp<RealtimeDatabase>(Database);
  Database.url(DATABASE_URL);

  oled.clearDisplay();
  oled.println("Sistema listo!");
  oled.display();
}

// =========================
// LOOP
// =========================
void loop() {
  app.loop();

  // RESET FLAGS
  if (resetNegar) {
    Database.set(aClient, "/movimiento/negar", 0);
    resetNegar = false;
  }

  if (resetDerecha) {
    Database.set(aClient, "/movimiento/derecha", 0);
    resetDerecha = false;
  }

  if (resetIzquierda) {
    Database.set(aClient, "/movimiento/izquierda", 0);
    resetIzquierda = false;
  }

  // OLED
  if (nuevoDatoRecibido) {
    oled.clearDisplay();

    if (valorEmocion == 1) {
      oled.drawBitmap(0,0,feliz_bitmap,128,64,WHITE);
    } else {
      oled.drawBitmap(0,0,cansado_bitmap,128,64,WHITE);
    }

    oled.display();
    nuevoDatoRecibido = false;
  }

  // CONSULTAS FIREBASE
  if (app.ready() && (millis() - ultimaPeticion > intervalo)) {
    ultimaPeticion = millis();

    Database.get(aClient, "/movimiento/negar", processData);
    Database.get(aClient, "/movimiento/derecha", processData);
    Database.get(aClient, "/movimiento/izquierda", processData);
    Database.get(aClient, "/expresiones/feliz", processData);
  }
}
